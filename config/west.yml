## config/west.yml
```yaml
manifest:
  remotes:
      # Additional modules containing boards/shields/custom code can be listed here as well.
      # See:
      # - https://zmk.dev/docs/features/modules
      # - https://docs.zephyrproject.org/3.5.0/develop/west/manifest.html#projects
    - name: zmkfirmware
      url-base: https://github.com/zmkfirmware
    - name: urob
      url-base: https://github.com/urob
    - name: gpeye
      url-base: https://github.com/GPeye
    - name: m165437
      url-base: https://github.com/M165437
  projects:
    - name: eyelash_sofle
      url: https://github.com/a741725193/zmk-sofle
      revision: refactor
    - name: mario-peripheral-animation
      remote: gpeye
      revision: main 
    - name: zmk
      remote: urob
      revision: main
      import: app/west.yml
    - name: zmk-helpers
      remote: urob
      revision: main
    - name: nice-view-gem
      remote: m165437
      revision: main
  self:
    path: config
```
